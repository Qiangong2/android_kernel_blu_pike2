## drivers/misc/sprd_camera/common/Kconfig
```kconfig
config SPRD_CAM_PW_DOMAIN_R4P0
	bool "Spreadtrum Camera Power Domain R4P0 for Pike2"
	depends on SPRD_CAMERA
	help
            This is a power domain driver for Spreadtrum SOCs
            and pike2. This driver open and close some clocks for pike2 Cam Sys.
            If you want to use this config,
            please read spec and driver code, they can help you to use r4p0 driver

config SPRD_CAM_PW_DOMAIN_R5P0
	bool "Spreadtrum Camera Power Domain R5P0"
	depends on SPRD_CAMERA
	help
	    This is a power domain driver for cam & dispc sys.
```

## drivers/misc/sprd_camera/cpp/Kconfig
```kconfig
config SPRD_CAMERA_CPP_LITE_R3P0
	bool "Spreadtrum Camera CPP LITE R3P0 Driver"
	depends on SPRD_CAMERA
	help
	    Support for CPP on Spreadtrum SOCs, it is used for image rotation
	    and scaling when using camera.

config SPRD_CAMERA_CPP_DCAM_R6P0
        bool "Spreadtrum Camera pike2 CPP VERSION DCAM_R6P0"
        depends on SPRD_CAMERA
        help
            Support for CPP on Spreadtrum SOCs, it is used for image rotation
            and scaling when using camera.
```

## drivers/misc/sprd_camera/isp/Kconfig
```kconfig
config SPRD_CAMERA_ISP_R6P91
    bool "Spreadtrum Camera ISP_R6P91"
    depends on SPRD_CAMERA
    help
        This is ISP_R6P91 driver for Spreadtrum SOCs
        and pike2, if you want to use this config,
        please to read spec and driver code,
        they can help you to use r6p91 driver

config SPRD_CAMERA_ISP_R6P11
    bool "Spreadtrum Camera ISP R6P11"
    depends on SPRD_CAMERA
    help
        This is ISP R6P11 driver for Spreadtrum SOCs.
```

## drivers/misc/sprdwcn_bsp/sc23xx/platform/Kconfig
```kconfig
config WCN_BOOT
	tristate "Core Support"
	help
	Choose Y here if you have this FM radio chip.

	In order to control your radio card, you will need to use programs
	that are compatible with the Video For Linux 2 API.  Information on
	this API and pointers to "v4l2" programs may be found at
	<file:Documentation/video4linux/API.html>.

config WCN_PLATFORM
	tristate "Platform Support"
	depends on SC2342_INTEG
	default y
	help
	Enable this module for Spreadtrum WCN integration
	chip debug and manage function.

	In order to control or debug your marlin chip, you will need to support
	procfs command and memory dump,cp log and so on.
```
