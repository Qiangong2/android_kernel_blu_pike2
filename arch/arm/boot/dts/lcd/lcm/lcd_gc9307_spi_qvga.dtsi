/ { lcds {
	lcd_gc9307_spi_qvga: lcd9307@9307 {

		panel-name = "lcd_gc9307_spi_qvga";
		if-type = <4>;
		spi_bus_num = <1>;
		spi_cs = <0>;
		bpp = <16>;
		fps = <33>;
		spi_mode = <3>; /* SPI_CPHA 0x01 SPI_CPOL 0x02 */
		spi_cd_gpio = <160>;
		spi_te_gpio = <51>;
		spi_pol_mode = <0>;
		spi_endian = <0>;
		spi_freq = <48000000>;
		hactive = <240>;
		vactive = <320>;

		power-on-sequence = <
					50  1  5
					50  0  5
					50  1  20
					>;
		power-off-sequence = <
					50  0  20
					>;

		init-data = [
			ff  00  00  01  fe
			ff  00  00  01  ef
			ff  00  00  02  36  48
			ff  00  00  02  3a  05
			ff  00  00  02  35  00
			ff  00  00  03  44  00  10
			ff  00  00  01  21
			ff  00  00  02  85  ff

			ff  00  00  02  86  99
			ff  00  00  02  87  79
			ff  00  00  02  89  03
			
			
			ff  00  00  03  e8  12  b9
			ff  00  00  02  8b  80
			ff  00  00  02  8d  33
			ff  00  00  02  8e  8f
			ff  00  00  02  8f  73
			ff  00  00  02  a7  45
			ff  00  00  02  a8  0b
			ff  00  00  02  a9  8b
			ff  00  00  02  c3  4d
            ff  00  00  02  c4  0d

			
			
			
			ff  00  00  02  c9  3f
			ff  00  00  02  ff  61
			ff  00  00  02  bc  04
			ff  00  00  02  99  3e
			ff  00  00  02  9d  4b
			ff  00  00  02  98  3e
			ff  00  00  02  9c  4b


			ff  00  00  07  f0  88  0b  0c  0f  0a  3e
			ff  00  00  07  f1  50  97  b5  25  2e  bf
			ff  00  00  07  f2  44  1a  0a  0f  0c  52
			ff  00  00  07  f3  64  d7  b7  32  3b  ef

			ff  78  00  01  11
			ff  20  00  01  29
			ff  00  00  01  2c




			];
		sleep-in = [
			ff 78 00 01 28
			ff 78 00 01 10
			];
		sleep-out = [
			ff 78 00 01 11
			ff 20 00 01 29
			];
		enable-te = [
			ff 00 00 02 35 00
			];
		disable-te = [
			ff 00 00 01 34
			];
	};
};};

