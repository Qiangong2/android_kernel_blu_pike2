/ { lcds {
	lcd_ili9340x_spi_qvga: lcd9340@9340 {

		panel-name = "lcd_ili9340x_spi_qvga";
		if-type = <4>;
		spi_bus_num = <1>;
		spi_cs = <0>;
		bpp = <16>;
		/* fps = <33>; */
		spi_mode = <3>; /* SPI_CPHA 0x01 SPI_CPOL 0x02 */
		spi_cd_gpio = <12>;
		spi_te_gpio = <33>;
		spi_pol_mode = <0>;
		spi_endian = <0>;
		spi_freq = <48000000>;
		hactive = <240>;
		vactive = <320>;

		power-on-sequence = <
					50  1  5
					50  0  5
					50  1  20
					>;
		power-off-sequence = <
					50  0  20
					>;

		init-data = [
		
			ff  00  00  02  B4  80
			ff  00  00  08  B7  FF  44  04  44  04  02  04
			ff  00  00  04  BA  10  13  20
			ff  00  00  04  BB  54  66  33
			ff  00  00  04  CD  20  20  00
			ff  00  00  06  E8  11  11  33  33  55
			ff  00  00  0A  E9  40  84  65  30  C0  00  FF  77  BB
			ff  00  00  08  EA  01  22  3F  E2  04  00  00
			ff  00  00  03  F2  00  00
			ff  00  00  02  F5  88
			ff  00  00  10  E4  00  02  0B  06  11  08  39  77  4D  07  0B  09  1F  20  0F
			ff  00  00  10  E5  00  03  0B  07  17  09  3F  46  4A  04  0D  0B  1E  24  0F
			ff  00  00  06  BC  00  10  00  10  0B
			
			ff  00  00  02  3A  55
			ff  00  00  02  35  00
			ff  78  00  01  11
			ff  20  00  01  29	
			ff  00  00  01  2c
			];
		sleep-in = [
			ff 78 00 01 28
			ff 78 00 01 10
			];
		sleep-out = [
			ff 78 00 01 11
			ff 64 00 01 29
			];
		enable-te = [
			ff 00 00 02 35 00
			];
		disable-te = [
			ff 00 00 01 34
			];
	};
};};

