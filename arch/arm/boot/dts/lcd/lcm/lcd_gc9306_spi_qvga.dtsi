/ { lcds {
	lcd_gc9306_spi_qvga: lcd9306@9306 {

		panel-name = "lcd_gc9306_spi_qvga";
		if-type = <4>;
		spi_bus_num = <1>;
		spi_cs = <0>;
		bpp = <16>;
		fps = <33>;
		spi_mode = <3>; /* SPI_CPHA 0x01 SPI_CPOL 0x02 */
		spi_cd_gpio = <12>;
		spi_te_gpio = <33>;
		spi_pol_mode = <0>;
		spi_endian = <0>;
		spi_freq = <48000000>;
		hactive = <240>;
		vactive = <320>;

		power-on-sequence = <
					32  1  5
					32  0  5
					32  1  20
					>;
		power-off-sequence = <
					32  0  20
					>;

		init-data = [
			ff  00  00  01  fe
			ff  00  00  01  ef
					
			ff  00  00  02  36  48
			ff  00  00  02  3a  05
			
			ff  00  00  02  35  00
			ff  00  00  03  44  00  0a
			
			ff  00  00  03  a4  44  44
			ff  00  00  03  a5  42  42
			ff  00  00  03  aa  88  88
			
			ff  00  00  03  e8  12  0b
			ff  00  00  03  e3  01  10
			
			ff  00  00  02  ff  61
			ff  00  00  02  ac  00
			ff  00  00  02  ad  33
			ff  00  00  02  ae  2b	
			ff  00  00  02  af  55
			
			ff  00  00  03  a6  2a  2a
			ff  00  00  03  a7  2b  2b
			ff  00  00  03  a8  18  18
			ff  00  00  03  a9  2a  2a
			
			ff  00  00  07  f0  02  01  00  00  00  03
			ff  00  00  07  f1  01  01  00  00  14  16
			ff  00  00  07  f2  03  05  1f  05  05  31
			ff  00  00  07  f3  17  0d  53  04  03  64
			ff  00  00  07  f4  0d  18  17  04  06  0f
			ff  00  00  07  f5  06  15  14  33  32  0f
			ff  78  00  01  11
			ff  20  00  01  29
			ff  00  00  01  2c
			];
		sleep-in = [
			ff 78 00 01 28
			ff 78 00 01 10
			];
		sleep-out = [
			ff 78 00 01 11
			ff 64 00 01 29
			];
		enable-te = [
			ff 00 00 02 35 00
			];
		disable-te = [
			ff 00 00 01 34
			];
	};
};};


