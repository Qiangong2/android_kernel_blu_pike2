/ { lcds {
	lcd_gc9307_spi_qvga: lcd9307@9307 {

		panel-name = "lcd_gc9307_spi_qvga";
		if-type = <4>;
		spi_bus_num = <1>;
		spi_cs = <0>;
		bpp = <16>;
		fps = <33>;
		spi_mode = <3>; /* SPI_CPHA 0x01 SPI_CPOL 0x02 */
		spi_cd_gpio = <60>;
		spi_te_gpio = <33>;
		spi_pol_mode = <0>;
		spi_endian = <0>;
		spi_freq = <48000000>;
		hactive = <240>;
		vactive = <320>;

		power-on-sequence = <
					32  1  5
					32  0  5
					32  1  20
					>;
		power-off-sequence = <
					32  0  20
					>;

		init-data = [
			ff  00  00  01  fe
			ff  00  00  01  ef
			ff  00  00  02  35  00
			ff  00  00  02  36  48
			ff  00  00  02  3a  05
			ff  00  00  01  21
			ff  00  00  02  86  98
			ff  00  00  02  c9  0a
			ff  00  00  02  89  03
			ff  00  00  03  e8  12  40
			ff  00  00  02  c3  45
			ff  00  00  02  c4  20
			ff  00  00  02  8b  80
			ff  00  00  02  ff  62
			ff  00  00  02  8d  22
			ff  00  00  02  99  3e
			ff  00  00  02  9d  4b
			ff  00  00  02  8e  0f
			ff  00  00  07  f0  80  00  0c  0c  08  3d
			ff  00  00  07  f1  55  9a  b8  2e  32  cf
			ff  00  00  07  f2  40  00  09  0b  09  30
			ff  00  00  07  f3  43  b7  98  11  13  cf
			ff  78  00  01  11
			ff  20  00  01  29
			ff  00  00  01  2c
			];
		sleep-in = [
			ff 78 00 01 28
			ff 78 00 01 10
			];
		sleep-out = [
			ff 78 00 01 11
			ff 64 00 01 29
			];
		enable-te = [
			ff 00 00 02 35 00
			];
		disable-te = [
			ff 00 00 01 34
			];
	};
};};

